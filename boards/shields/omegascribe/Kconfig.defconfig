## boards/shields/omegascribe/Kconfig.defconfig
```kconfig
if SHIELD_OMEGASCRIBE_L

config ZMK_KEYBOARD_NAME
    default "OmegaScribe"

config ZMK_SPLIT_ROLE_CENTRAL
    default y
endif

if SHIELD_OMEGASCRIBE_L || SHIELD_OMEGASCRIBE_R

config ZMK_SPLIT
    default y

endif
```

## boards/shields/omegascribe/Kconfig.shield
```kconfig
config SHIELD_OMEGASCRIBE_L
    def_bool $(shields_list_contains, omegascribe_l)

config SHIELD_OMEGASCRIBE_R
    def_bool $(shields_list_contains, omegascribe_r)
```

## boards/shields/sofletoshi/Kconfig.defconfig
```kconfig
if SHIELD_CORAX56_LEFT

config ZMK_KEYBOARD_NAME
    default "Sofle Toshi"

config ZMK_SPLIT_ROLE_CENTRAL
    default y
endif

if SHIELD_SOFLETOSHI_LEFT || SHIELD_SOFLETOSHI_RIGHT

config ZMK_SPLIT
    default y

endif
```

## boards/shields/sofletoshi/Kconfig.shield
```kconfig
config SHIELD_SOFLETOSHI_LEFT
    def_bool $(shields_list_contains,sofletoshi_left)

config SHIELD_SOFLETOSHI_RIGHT
    def_bool $(shields_list_contains,sofletoshi_right)
```

## config/boards/shields/omegascribe/Kconfig.defconfig
```kconfig
if SHIELD_OMEGASCRIBE_L

config ZMK_KEYBOARD_NAME
    default "OmegaScribe"

config ZMK_SPLIT_ROLE_CENTRAL
    default y
endif

if SHIELD_OMEGASCRIBE_LEFT || SHIELD_OMEGASCRIBE_RIGHT

config ZMK_SPLIT
    default y

endif
```
